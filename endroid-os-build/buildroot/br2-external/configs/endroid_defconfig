## endroid-os-build/buildroot/br2-external/configs/endroid_defconfig
```kconfig
BR2_EXTERNAL_ENDROID_PATH=$(pwd)/br2-external

# Target architecture - x86_64 for QEMU and most modern hardware
BR2_x86_64=y

# Kernel headers
BR2_PACKAGE_HOST_LINUX_HEADERS_CUSTOM_6_6=y

# System configuration
BR2_TARGET_GENERIC_HOSTNAME="endroid"
BR2_TARGET_GENERIC_ISSUE="Endroid OS"
BR2_ROOTFS_POST_IMAGE_SCRIPT=y
BR2_ROOTFS_POST_SCRIPT_ARGS=""

# Init system - using s6 for minimal footprint
BR2_INIT_NONE=y
BR2_PACKAGE_S6_RC=y
BR2_PACKAGE_S6_PORTABLE_UTILS=y

# Essential system tools
BR2_PACKAGE_BUSYBOX_SHOW_OTHERS=y
BR2_PACKAGE_UTIL_LINUX=y
BR2_PACKAGE_UTIL_LINUX_LSblk=y
BR2_PACKAGE_UTIL_LINUX_MOUNT=y
BR2_PACKAGE_UTIL_LINUX_UMOUNT=y
BR2_PACKAGE_E2FSPROGS=y
BR2_PACKAGE_DOSFSTOOLS=y

# D-Bus (required for hardware services)
BR2_PACKAGE_DBUS=y
BR2_PACKAGE_DBUS_TOOLS=y

# Network management - connman for minimal footprint
BR2_PACKAGE_CONNMAN=y
BR2_PACKAGE_CONNMAN_CLIENT=y

# Graphics/display stack
BR2_PACKAGE_MESA3D=y
BR2_PACKAGE_MESA3D_GALLIUM_DRIVER_VIRGL=y
BR2_PACKAGE_MESA3D_OPENGL_EGL=y

# WebKitGTK + cog browser launcher
BR2_PACKAGE_WPEWEBKIT=y
BR2_PACKAGE_COG=y

# Custom daemon package
BR2_PACKAGE_ENDROIDD=y

# Filesystem support
BR2_EXT4=y
BR2_SQUASHFS=y
BR2_TARGET_ROOTFS_SQUASHFS=y

# Disable unnecessary features for size
BR2_USE_MMU=y
BR2_TOOLCHAIN_BUILDROOT_LIBC="musl"
BR2_TOOLCHAIN_BUILDROOT_MUSL=y

# Optimization for size
BR2_OPTIMIZE_SIZE=y
BR2_FORTIFY_SOURCE_NONE=y
```

## endroid-os-build/buildroot/br2-external/package/endroidd/Config.in
```kconfig
config BR2_PACKAGE_ENDROIDD
	bool "endroidd"
	help
	  Endroid OS hardware bridge daemon.
	  Provides REST API for system info, preferences, network,
	  power/battery, and app management.
```

## endroid-os-build/kernel/endroid_defconfig
```kconfig
# Linux kernel configuration for Endroid OS
# Based on tinyconfig with additions for target hardware

CONFIG_64BIT=y
CONFIG_X86_64=y
CONFIG_X86=y

# Tinyconfig baseline
# CONFIG_CC_OPTIMIZE_FOR_PERFORMANCE is not set
CONFIG_CC_OPTIMIZE_FOR_SIZE=y
CONFIG_KERNEL_LZ4=y

# Essential filesystems
CONFIG_EXT4_FS=y
CONFIG_SQUASHFS=y
CONFIG_SQUASHFS_LZ4=y
CONFIG_VFAT_FS=y
CONFIG_OVERLAY_FS=m

# Device filesystem
CONFIG_DEVTMPFS=y
CONFIG_DEVTMPFS_MOUNT=y
CONFIG_TMPFS=y

# DRM/KMS for display (virtio-gpu for QEMU, add real drivers later)
CONFIG_DRM=y
CONFIG_DRM_VIRTIO_GPU=y
CONFIG_DRM_KMS_HELPER=y
CONFIG_FB=y
CONFIG_FRAMEBUFFER_CONSOLE=y

# Storage drivers
CONFIG_ATA=y
CONFIG_AHCI=y
CONFIG_BLK_DEV_NVME=y
CONFIG_VIRTIO_BLK=y

# Input devices
CONFIG_INPUT_EVDEV=y
CONFIG_USB_HID=y
CONFIG_HID_GENERIC=y
CONFIG_USB_KEYBOARD=y
CONFIG_USB_MOUSE=y

# Networking
CONFIG_NET=y
CONFIG_INET=y
CONFIG_VIRTIO_NET=y
CONFIG_E1000=y
CONFIG_E1000E=y
CONFIG_R8169=y

# Wireless (only if target has Wi-Fi)
# CONFIG_WIRELESS=y
# CONFIG_CFG80211=y
# CONFIG_MAC80211=y

# USB support
CONFIG_USB=y
CONFIG_USB_XHCI_HCD=y
CONFIG_USB_EHCI_HCD=y
CONFIG_USB_OHCI_HCD=y

# Console
CONFIG_SERIAL_8250=y
CONFIG_SERIAL_8250_CONSOLE=y
CONFIG_TTY=y

# Power management
CONFIG_PM=y
CONFIG_ACPI=y

# Misc essentials
CONFIG_PROC_FS=y
CONFIG_SYSFS=y
CONFIG_BINFMT_ELF=y
CONFIG_BINFMT_SCRIPT=y
CONFIG_UNIX=y
CONFIG_SIGNALFD=y
CONFIG_TIMERFD=y
CONFIG_EVENTFD=y

# Disable unnecessary features for size
# CONFIG_PRINTK is not set
# CONFIG_DMI is not set
```
